## linux-5.4.31/drivers/andy/Kconfig
```kconfig
menu "Andy's drivers"

config ANDY_LED
	tristate "Andy LED driver (STM32MP157)"
	depends on OF && ARCH_STM32
	help
	  Character driver for the user LED on the STM32MP157 board,
	  driven by writing 1/0 to /dev/andyled. Register addresses come
	  from the "reg" property of the /andy_led device tree node.

	  To compile this driver as a module, choose M here: the module
	  will be called andyled.

config ANDY_BEEP
	tristate "Andy beep driver (STM32MP157)"
	depends on OF && GPIOLIB
	help
	  Character driver for the on-board buzzer of the STM32MP157 board,
	  driven by writing 1/0 to /dev/andybeep. The GPIO comes from the
	  "beep-gpio" property of the /andybeep device tree node.

	  To compile this driver as a module, choose M here: the module
	  will be called andybeep.

endmenu
```
